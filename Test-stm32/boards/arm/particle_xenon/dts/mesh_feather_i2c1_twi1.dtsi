/*
 * Copyright (c) 2018 Peter Bigot Consulting, LLC
 *
 * SPDX-License-Identifier: Apache-2.0
 */

/* Add I2C1 support on Particle Mesh via nRF52840 TWI1
 *
 * NOTE: This file is replicated in particle_{argon,xenon}.
 * Changes should be made in all instances. */
&i2c1 { /* feather I2C1 */
	status = "okay";
	sda-pin = <33>;
	scl-pin = <34>;
        ssd1306@3c {
                compatible = "solomon,ssd1306fb-i2c";
                reg = <0x3c>;
                label = "SSD1306";
                width = <128>;
                height = <64>;
                segment-offset = <0>;
                page-offset = <0>;
                display-offset = <0>;
                segment-remap;
                com-invdir;
                prechargep = <0x22>;
        };
};

